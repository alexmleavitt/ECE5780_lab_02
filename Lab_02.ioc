# file: Lab_02.ioc
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Mcu.Family=STM32F0
Mcu.Name=STM32F072R(8-B)Tx
Mcu.Package=LQFP64
ProjectManager.HeapSize=0x200
ProjectManager.StackSize=0x400
ProjectManager.TargetToolchain=MDK-ARM V5
board=custom

// file: Core/Src/main.c
/* USER CODE BEGIN Header */
/**
  ******************************************************************************
  * @file           : main.c
  * @brief          : Main program body
  ******************************************************************************
  * @attention
  *
  * Copyright (c) 2024 STMicroelectronics.
  * All rights reserved.
  *
  * This software is licensed under terms that can be found in the LICENSE file
  * in the root directory of this software component.
  * If no LICENSE file comes with this software, it is provided AS-IS.
  *
  ******************************************************************************
  */
/* USER CODE END Header */
#include "main.h"
volatile int32_t i;

void SystemClock_Config(void);
/* USER CODE BEGIN PFP */
void EXTI0_1_IRQHandler(void);
/* USER CODE END PFP */

int main(void)
{
  // Enable clock for needed peripherals
	RCC->AHBENR |= RCC_AHBENR_GPIOCEN;
	RCC->AHBENR |= RCC_AHBENR_GPIOAEN;
	RCC->APB2ENR |= RCC_APB2ENR_SYSCFGEN;

	SystemClock_Config();

	// Set up the leds
	GPIOC->MODER |= (1<<12) | (1<<14) | (1<<16) | (1<<18);
	GPIOC->MODER &= ~((1<<13) | (1<<15) | (1<<17) | (1<<19));
	GPIOC->OTYPER &= ~((1<<6) | (1<<7) | (1<<8) | (1<<9));
	GPIOC->OSPEEDR &= ~((1<<12) | (1<<14) | (1<<16) | (1<<18));
	GPIOC->PUPDR &= ~((1<<12) | (1<<14) | (1<<16) | (1<<18)
									| (1<<13) | (1<<15) | (1<<17) | (1<<19));

	// Set up the button
	GPIOA->MODER &= ~((1<<0) | (1<<1));
	GPIOC->OSPEEDR &= ~((1<<0) | (1<<1));
	GPIOA->PUPDR &= ~((1<<0));
	GPIOA->PUPDR |= (1<<1);

	// Configure EXTI settings
	EXTI->IMR |= (1<<0);
	EXTI->EMR |= (1<<0);
	EXTI->RTSR |= (1<<0);

	SYSCFG->EXTICR[0] &= ~((1<<0) | (1<<1) | (1<<2) | (1<<3));

	// Set the priority for interrupts
	// interrupt 5 is from EXTI0
	NVIC_EnableIRQ(5);
	NVIC_SetPriority(5,3);
	// interrupt -1 is from SysTick
	NVIC_SetPriority(-1,2);

	// Reset the leds to on or off
	// green and blue are on, red is off
	GPIOC->ODR |= (1<<9);
	GPIOC->ODR &= ~(1<<6);
	GPIOC->ODR |= (1<<7);

  while (1)
  {
		// Use HAL_Delay to toggle the red led
	GPIOC->ODR ^= (1<<6);
	HAL_Delay(400);
  }

}

void SystemClock_Config(void)
{
  RCC_OscInitTypeDef RCC_OscInitStruct = {0};
  RCC_ClkInitTypeDef RCC_ClkInitStruct = {0};

  /** Initializes the RCC Oscillators according to the specified parameters
  * in the RCC_OscInitTypeDef structure.
  */
  RCC_OscInitStruct.OscillatorType = RCC_OSCILLATORTYPE_HSI;
  RCC_OscInitStruct.HSIState = RCC_HSI_ON;
  RCC_OscInitStruct.HSICalibrationValue = RCC_HSICALIBRATION_DEFAULT;
  RCC_OscInitStruct.PLL.PLLState = RCC_PLL_NONE;
  if (HAL_RCC_OscConfig(&RCC_OscInitStruct) != HAL_OK)
  {
    Error_Handler();
  }

  /** Initializes the CPU, AHB and APB buses clocks
  */
  RCC_ClkInitStruct.ClockType = RCC_CLOCKTYPE_HCLK|RCC_CLOCKTYPE_SYSCLK
                              |RCC_CLOCKTYPE_PCLK1;
  RCC_ClkInitStruct.SYSCLKSource = RCC_SYSCLKSOURCE_HSI;
  RCC_ClkInitStruct.AHBCLKDivider = RCC_SYSCLK_DIV1;
  RCC_ClkInitStruct.APB1CLKDivider = RCC_HCLK_DIV1;

  if (HAL_RCC_ClockConfig(&RCC_ClkInitStruct, FLASH_LATENCY_0) != HAL_OK)
  {
    Error_Handler();
  }
}

/* USER CODE BEGIN 4 */
/**
 * Handler for EXTI0. It will be called
 * when the user button is pushed.
 *
*/
void EXTI0_1_IRQHandler(void)
{
	i = 0;

	// toggle the leds
	GPIOC->ODR ^= (1<<8);
	GPIOC->ODR ^= (1<<9);

	// loop to delay
	while(i<1500000)
	{
		i++;
	}

	// toggle the leds
	GPIOC->ODR ^= (1<<8);
	GPIOC->ODR ^= (1<<9);

	// clear the flag
	EXTI->PR |= (1<<0);
}
/* USER CODE END 4 */

void Error_Handler(void)
{
  __disable_irq();
  while (1)
  {
  }
}
